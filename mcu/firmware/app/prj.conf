## CMakeLists.txt
```
# SPDX-License-Identifier: Apache-2.0

cmake_minimum_required(VERSION 3.20.0)

find_package(Zephyr REQUIRED HINTS $ENV{ZEPHYR_BASE})
project(cepdt_mcu_app)

target_sources(app PRIVATE src/main.c)

target_sources(app PRIVATE src/engine_config_table.c)

target_sources(app PRIVATE src/engine_guards.c)

target_sources(app PRIVATE src/engine_fsm.c)

target_sources(app PRIVATE src/engine_auth.c)

if(CEPDT_ENGINE_GROUND_AUTH_ENABLED)
  target_compile_definitions(app PRIVATE ENGINE_GROUND_AUTH_ENABLED=1)
endif()

target_sources(app PRIVATE src/engine_persistence.c)
target_sources(app PRIVATE src/engine_persistence_io_zephyr.c)
target_sources_ifdef(CONFIG_SOC_SERIES_STM32L4X app PRIVATE src/engine_flash_ecc_stm32l4.c)

if(CEPDT_ENGINE_PERSIST_TESTHOOKS_ENABLED)
  target_compile_definitions(app PRIVATE ENGINE_PERSIST_TESTHOOKS_ENABLED=1)
endif()

target_sources(app PRIVATE src/engine_scheduler.c)

target_sources(app PRIVATE src/engine_arbitration.c src/engine_arbitration_table.c)

if(CEPDT_ENGINE_SCHED_TESTHOOKS_ENABLED)
  target_compile_definitions(app PRIVATE ENGINE_SCHED_TESTHOOKS_ENABLED=1)
endif()
```

## prj.conf
```kconfig
CONFIG_SERIAL=y
CONFIG_UART_INTERRUPT_DRIVEN=y
CONFIG_CONSOLE=n
CONFIG_UART_CONSOLE=n

CONFIG_ISR_STACK_SIZE=8192

CONFIG_MBEDTLS=y
CONFIG_MBEDTLS_MD=y
CONFIG_MBEDTLS_SHA256=y

CONFIG_CRC=y
CONFIG_FLASH=y
CONFIG_FLASH_MAP=y
```

## boards/nucleo_l476rg.overlay
```dts
&flash0 {
	partitions {
		slot0_partition: partition@7f800 {
			label = "image-0";
			reg = <0x0007f800 DT_SIZE_K(2)>;
		};

		slot1_partition: partition@f7800 {
			label = "image-1";
			reg = <0x000f7800 DT_SIZE_K(2)>;
		};
	};
};
```

## src/main.c
```c
/* SPDX-License-Identifier: Apache-2.0 */

#include <zephyr/kernel.h>
#include <zephyr/device.h>
#include <zephyr/drivers/uart.h>

#include <stdbool.h>
#include <stdint.h>
#include <stdio.h>
#include <stdlib.h>
#include <string.h>

#include "engine_fsm.h"
#include "engine_persistence.h"
#include "engine_arbitration.h"
#include "engine_auth.h"
#include "engine_scheduler.h"

#define UART_DEVICE_NODE DT_CHOSEN(zephyr_console)

static const struct device *const uart_dev = DEVICE_DT_GET(UART_DEVICE_NODE);


#define LINE_BUF_SIZE 512

static char line_buf[LINE_BUF_SIZE];
static size_t line_len;
static bool line_overflowed;

static void uart_write_str(const char *s)
{
    while (*s != '\0') {
        uart_poll_out(uart_dev, (uint8_t)*s);
        s++;
    }
}

static void uart_write_line_end(void)
{
    uart_poll_out(uart_dev, '\n');
}

static void reply_error(const char *reason)
{
    uart_write_str("ERROR ");
    uart_write_str(reason);
    uart_write_line_end();
}

static void reply_error_detail(const char *reason, const char *detail)
{
    uart_write_str("ERROR ");
    uart_write_str(reason);
    uart_write_str(" ");
    uart_write_str(detail);
    uart_write_line_end();
}

#if ENGINE_PERSIST_TESTHOOKS_ENABLED || ENGINE_SCHED_TESTHOOKS_ENABLED

static void reply_ok(void)
{
    uart_write_str("OK");
    uart_write_line_end();
}
#endif


static void format_double(double value, char *out, size_t out_size)
{
    bool negative = value < 0.0;
    if (negative) {
        value = -value;
    }
    long int_part = (long)value;
    double frac = value - (double)int_part;
    long frac_scaled = (long)(frac * 1000000.0 + 0.5);
    if (frac_scaled >= 1000000L) {
        int_part += 1;
        frac_scaled -= 1000000L;
    }
    if (frac_scaled == 0) {
        snprintf(out, out_size, "%s%ld", negative ? "-" : "", int_part);
        return;
    }

    char frac_buf[16];
    snprintf(frac_buf, sizeof(frac_buf), "%06ld", frac_scaled);
    size_t frac_len = strlen(frac_buf);
    while (frac_len > 1 && frac_buf[frac_len - 1] == '0') {
        frac_len--;
    }
    frac_buf[frac_len] = '\0';
    snprintf(out, out_size, "%s%ld.%s", negative ? "-" : "", int_part, frac_buf);
}

static void send_decision_line(double now, const char *from_state, const char *event_id,
                                const char *to_state, const char *transition_id, bool legal,
                                const action_t *actions, uint8_t actions_count)
{
    char now_buf[32];

    format_double(now, now_buf, sizeof(now_buf));

    uart_write_str("DECISION ");
    uart_write_str(now_buf);
    uart_write_str(" ");
    uart_write_str(from_state);
    uart_write_str(" ");
    uart_write_str(event_id);
    uart_write_str(" -> ");
    uart_write_str(to_state);
    uart_write_str(" transition=");
    uart_write_str(transition_id != NULL ? transition_id : "NONE");
    uart_write_str(" legal=");
    uart_write_str(legal ? "1" : "0");
    uart_write_str(" actions=");
    if (actions_count == 0) {
        uart_write_str("NONE");
    } else {
        for (uint8_t i = 0; i < actions_count; i++) {
            if (i > 0) {
                uart_write_str(",");
            }
            uart_write_str(actions[i].raw);
        }
    }
    uart_write_line_end();
}


static char *next_token(char **cursor)
{
    char *p = *cursor;

    while (*p == ' ') {
        p++;
    }
    if (*p == '\0') {
        *cursor = p;
        return NULL;
    }
    char *start = p;

    while (*p != '\0' && *p != ' ') {
        p++;
    }
    if (*p != '\0') {
        *p = '\0';
        p++;
    }
    *cursor = p;
    return start;
}


static bool looks_like_number(const char *s)
{
    const char *p = s;

    if (*p == '-') {
        p++;
    }
    if (*p < '0' || *p > '9') {
        return false;
    }
    while (*p >= '0' && *p <= '9') {
        p++;
    }
    if (*p == '.') {
        p++;
        if (*p < '0' || *p > '9') {
            return false;
        }
        while (*p >= '0' && *p <= '9') {
            p++;
        }
    }
    return *p == '\0';
}

static val_t parse_wire_value(const char *token)
{
    if (strcmp(token, "true") == 0) {
        return (val_t){ .kind = VAL_BOOL, .b = true };
    }
    if (strcmp(token, "false") == 0) {
        return (val_t){ .kind = VAL_BOOL, .b = false };
    }
    if (looks_like_number(token)) {
        return (val_t){ .kind = VAL_NUM, .num = strtod(token, NULL) };
    }
    return (val_t){ .kind = VAL_STR, .str = token };
}

static bool parse_kv(char *token, const char **out_key, val_t *out_value)
{
    char *eq = strchr(token, '=');

    if (eq == NULL || eq == token) {
        return false;
    }
    *eq = '\0';
    *out_key = token;
    *out_value = parse_wire_value(eq + 1);
    return true;
}

static bool is_valid_hex64(const char *s)
{
    size_t n = strlen(s);

    if (n != 64) {
        return false;
    }
    for (size_t i = 0; i < n; i++) {
        char c = s[i];
        bool is_hex = (c >= '0' && c <= '9') || (c >= 'a' && c <= 'f') || (c >= 'A' && c <= 'F');
        if (!is_hex) {
            return false;
        }
    }
    return true;
}


static bool parse_context_and_telemetry(char **cursor, engine_context_t *ctx, engine_telemetry_t *tlm,
                                        const char **signature, bool service)
{
    engine_context_init(ctx);
    engine_telemetry_init(tlm);

    bool saw_semicolon = false;
    char *tok;
    while ((tok = next_token(cursor)) != NULL) {
        if (strcmp(tok, ";") == 0) {
            saw_semicolon = true;
            break;
        }
        const char *key;
        val_t value;
        if (!parse_kv(tok, &key, &value)) {
            reply_error_detail("bad_context_kv", tok);
            return false;
        }
        if (!engine_context_set(ctx, key, value)) {
            reply_error_detail("context_overflow", key);
            return false;
        }
    }
    if (!saw_semicolon) {
        reply_error("missing_semicolon_separator");
        return false;
    }

    *signature = NULL;
    while ((tok = next_token(cursor)) != NULL) {
        if (service && strcmp(tok, ";") == 0) {
            return true;
        }
        if (!service && strcmp(tok, "SIG") == 0) {
            char *sig_tok = next_token(cursor);
            if (sig_tok == NULL || !is_valid_hex64(sig_tok)) {
                reply_error("bad_signature");
                return false;
            }
            *signature = sig_tok;
            if (next_token(cursor) != NULL) {
                reply_error("trailing_tokens_after_sig");
                return false;
            }
            break;
        }
        const char *key;
        val_t value;
        if (!parse_kv(tok, &key, &value)) {
            reply_error_detail("bad_telemetry_kv", tok);
            return false;
        }
        if (value.kind != VAL_NUM) {
            reply_error_detail("telemetry_value_not_numeric", key);
            return false;
        }
        if (!engine_telemetry_set(tlm, key, value.num)) {
            reply_error_detail("telemetry_overflow", key);
            return false;
        }
    }
    if (service) {
        reply_error("missing_semicolon_separator");
        return false;
    }
    return true;
}


static bool fire_event(state_id_t state, event_id_t event, double now, const engine_context_t *ctx,
                       const engine_telemetry_t *tlm, const char *signature, bool *legal)
{

    engine_persisted_snapshot_t persisted;
    bool has_persisted = engine_persistence_load(&persisted);

    engine_step_result_t result;
    engine_context_t out_ctx;
    const char *error_field = NULL;
    engine_step_status_t status = engine_fsm_step(
        state, event, ctx, tlm, now,
        has_persisted ? &persisted : NULL,
        signature,
        &result, &out_ctx, &error_field);

    if (status == ENGINE_STEP_ERR_GUARD_TELEMETRY_MISSING) {

        reply_error_detail("guard_telemetry_missing", error_field != NULL ? error_field : "(unknown)");
        return false;
    }

    if (result.legal) {

        engine_persistence_save(result.new_state, &out_ctx);
    }

    send_decision_line(now, g_states[state].id, g_events[event].id,
                        g_states[result.new_state].id, result.transition_id,
                        result.legal, result.actions, result.actions_count);
    *legal = result.legal;
    return true;
}

static void handle_inject(char *args)
{
    char *cursor = args;
    char *event_tok = next_token(&cursor);
    char *state_tok = next_token(&cursor);
    char *now_tok = next_token(&cursor);

    if (event_tok == NULL || state_tok == NULL || now_tok == NULL) {
        reply_error("missing_fields");
        return;
    }

    event_id_t event;
    if (!engine_lookup_event(event_tok, &event)) {
        reply_error_detail("unknown_event", event_tok);
        return;
    }
    state_id_t state;
    if (!engine_lookup_state(state_tok, &state)) {
        reply_error_detail("unknown_state", state_tok);
        return;
    }

    char *now_endptr = NULL;
    double now = strtod(now_tok, &now_endptr);
    if (now_endptr == now_tok || *now_endptr != '\0') {
        reply_error_detail("bad_now", now_tok);
        return;
    }

    engine_context_t ctx;
    engine_telemetry_t tlm;
    const char *signature;
    if (!parse_context_and_telemetry(&cursor, &ctx, &tlm, &signature, false)) {
        return;
    }

    bool legal;
    (void)fire_event(state, event, now, &ctx, &tlm, signature, &legal);
}


static void handle_service(char *args)
{
    char *cursor = args;
    char *state_tok = next_token(&cursor);
    char *now_tok = next_token(&cursor);

    if (state_tok == NULL || now_tok == NULL) {
        reply_error("missing_fields");
        return;
    }

    state_id_t state;
    if (!engine_lookup_state(state_tok, &state)) {
        reply_error_detail("unknown_state", state_tok);
        return;
    }

    char *now_endptr = NULL;
    double now = strtod(now_tok, &now_endptr);
    if (now_endptr == now_tok || *now_endptr != '\0') {
        reply_error_detail("bad_now", now_tok);
        return;
    }

    engine_context_t ctx;
    engine_telemetry_t tlm;
    const char *signature;
    if (!parse_context_and_telemetry(&cursor, &ctx, &tlm, &signature, true)) {
        return;
    }

    engine_pending_event_t pending[EVENT_COUNT];
    size_t n = 0;
    char *tok;
    while ((tok = next_token(&cursor)) != NULL) {
        char *at = strchr(tok, '@');
        char *ts_endptr = NULL;
        if (at == NULL) {
            reply_error_detail("bad_pending_event", tok);
            return;
        }
        *at = '\0';
        double timestamp = strtod(at + 1, &ts_endptr);
        if (ts_endptr == at + 1 || *ts_endptr != '\0' || n == EVENT_COUNT ||
            !engine_lookup_event(tok, &pending[n].event)) {
            reply_error_detail("bad_pending_event", tok);
            return;
        }
        pending[n++].timestamp = timestamp;
    }

    size_t order[EVENT_COUNT];
    engine_arbitrate(pending, n, order);

    size_t next = 0;
    bool legal = false;
    while (next < n && !legal) {
        if (!fire_event(state, pending[order[next]].event, now, &ctx, &tlm, NULL, &legal)) {
            return;
        }
        next++;
    }

    uart_write_str("SERVICED");
    for (; legal && next < n; next++) {
        uart_write_str(" ");
        uart_write_str(g_events[pending[order[next]].event].id);
    }
    uart_write_line_end();
}


#if ENGINE_PERSIST_TESTHOOKS_ENABLED

static bool handle_testhook_load(void)
{
    engine_persisted_snapshot_t snap;

    if (!engine_persistence_load(&snap)) {
        reply_error("testhook_load_no_record");
        return true;
    }

    val_t latch_value;
    bool has_latch = engine_context_get(&snap.context, "deployment_confirmed", &latch_value);

    bool latch_true = has_latch && latch_value.kind == VAL_BOOL && latch_value.b;

    uart_write_str("OK state=");
    uart_write_str(g_states[snap.state].id);
    uart_write_str(" deployment_confirmed=");
    uart_write_str(latch_true ? "1" : "0");
    uart_write_line_end();
    return true;
}


static bool handle_testhook_corrupt(char *cursor)
{
    char *bank_tok = next_token(&cursor);
    if (bank_tok == NULL || bank_tok[1] != '\0') {
        reply_error("bad_testhook_bank");
        return true;
    }

    engine_persist_bank_t bank;
    if (bank_tok[0] == 'A') {
        bank = ENGINE_PERSIST_BANK_A;
    } else if (bank_tok[0] == 'B') {
        bank = ENGINE_PERSIST_BANK_B;
    } else {
        reply_error("bad_testhook_bank");
        return true;
    }

    if (!engine_persistence_corrupt(bank)) {
        reply_error("testhook_corrupt_failed");
        return true;
    }

    reply_ok();
    return true;
}
#endif

#if ENGINE_SCHED_TESTHOOKS_ENABLED

static engine_scheduler_t g_test_scheduler;

static void reply_sched_item(const engine_sched_item_t *item)
{
    char size_buf[16];
    char deadline_buf[32];

    snprintf(size_buf, sizeof(size_buf), "%lu", (unsigned long)item->size_bytes);
    if (item->has_deadline) {
        format_double(item->deadline, deadline_buf, sizeof(deadline_buf));
    }

    uart_write_str("OK id=");
    uart_write_str(item->id);
    uart_write_str(" data_class=");
    uart_write_str(item->data_class);
    uart_write_str(" size_bytes=");
    uart_write_str(size_buf);
    uart_write_str(" deadline=");
    uart_write_str(item->has_deadline ? deadline_buf : "NONE");
    uart_write_line_end();
}


static bool handle_testhook_sched_reset(char *cursor)
{
    char *classes_tok = next_token(&cursor);
    if (classes_tok == NULL || next_token(&cursor) != NULL) {
        reply_error("bad_sched_reset_classes");
        return true;
    }

    if (strcmp(classes_tok, "NONE") == 0) {
        engine_scheduler_init(&g_test_scheduler, NULL, 0);
        reply_ok();
        return true;
    }

    const char *classes[ENGINE_SCHED_MAX_CLASSES];
    uint8_t n = 0;
    char *p = classes_tok;
    while (p != NULL) {
        if (n >= ENGINE_SCHED_MAX_CLASSES) {
            reply_error("bad_sched_reset_classes");
            return true;
        }
        char *comma = strchr(p, ',');
        if (comma != NULL) {
            *comma = '\0';
        }
        if (*p == '\0' || strlen(p) >= ENGINE_SCHED_CLASS_NAME_MAX) {
            reply_error("bad_sched_reset_classes");
            return true;
        }
        classes[n++] = p;
        p = (comma != NULL) ? comma + 1 : NULL;
    }

    engine_scheduler_init(&g_test_scheduler, classes, n);
    reply_ok();
    return true;
}


static bool handle_testhook_sched_insert(char *cursor)
{
    char *id_tok = next_token(&cursor);
    char *class_tok = next_token(&cursor);
    char *size_tok = next_token(&cursor);
    char *deadline_tok = next_token(&cursor);

    if (id_tok == NULL || class_tok == NULL || size_tok == NULL || deadline_tok == NULL ||
        next_token(&cursor) != NULL) {
        reply_error("bad_sched_insert_args");
        return true;
    }

    engine_sched_item_t item;
    memset(&item, 0, sizeof(item));

    if (strlen(id_tok) >= ENGINE_SCHED_ITEM_ID_MAX || strlen(class_tok) >= ENGINE_SCHED_CLASS_NAME_MAX) {
        reply_error("bad_sched_insert_args");
        return true;
    }
    strcpy(item.id, id_tok);
    strcpy(item.data_class, class_tok);

    char *size_endptr = NULL;
    unsigned long size_val = strtoul(size_tok, &size_endptr, 10);
    if (size_endptr == size_tok || *size_endptr != '\0') {
        reply_error("bad_sched_size_bytes");
        return true;
    }
    item.size_bytes = (uint32_t)size_val;

    if (strcmp(deadline_tok, "NONE") == 0) {
        item.has_deadline = false;
    } else {
        char *deadline_endptr = NULL;
        double deadline_val = strtod(deadline_tok, &deadline_endptr);
        if (deadline_endptr == deadline_tok || *deadline_endptr != '\0') {
            reply_error("bad_sched_deadline");
            return true;
        }
        item.has_deadline = true;
        item.deadline = deadline_val;
    }

    engine_sched_status_t status = engine_scheduler_insert(&g_test_scheduler, &item);
    if (status == ENGINE_SCHED_ERR_UNKNOWN_CLASS) {
        reply_error_detail("sched_unknown_class", item.data_class);
        return true;
    }
    if (status == ENGINE_SCHED_ERR_QUEUE_FULL) {
        reply_error("sched_queue_full");
        return true;
    }

    reply_ok();
    return true;
}

static bool handle_testhook_sched(char *args)
{
    char *cursor = args;
    char *op_tok = next_token(&cursor);

    if (op_tok == NULL) {
        return false;
    }

    if (strcmp(op_tok, "RESET") == 0) {
        return handle_testhook_sched_reset(cursor);
    }
    if (strcmp(op_tok, "INSERT") == 0) {
        return handle_testhook_sched_insert(cursor);
    }
    if (strcmp(op_tok, "SELECT") == 0 || strcmp(op_tok, "SELECT_EDF") == 0) {
        engine_sched_key_fn key = (strcmp(op_tok, "SELECT_EDF") == 0) ? engine_scheduler_edf_key : NULL;
        engine_sched_item_t out;
        if (engine_scheduler_select_next(&g_test_scheduler, key, &out)) {
            reply_sched_item(&out);
        } else {
            uart_write_str("OK NONE");
            uart_write_line_end();
        }
        return true;
    }
    if (strcmp(op_tok, "PEEK_CLASS") == 0) {
        char class_buf[ENGINE_SCHED_CLASS_NAME_MAX];
        if (engine_scheduler_peek_next_class(&g_test_scheduler, class_buf, sizeof(class_buf))) {
            uart_write_str("OK data_class=");
            uart_write_str(class_buf);
            uart_write_line_end();
        } else {
            uart_write_str("OK NONE");
            uart_write_line_end();
        }
        return true;
    }
    if (strcmp(op_tok, "CANDIDATES") == 0) {
        char classes[ENGINE_SCHED_QUEUE_CAPACITY][ENGINE_SCHED_CLASS_NAME_MAX];
        uint8_t n = engine_scheduler_candidate_classes(&g_test_scheduler, classes, ENGINE_SCHED_QUEUE_CAPACITY);
        if (n == 0) {
            uart_write_str("OK classes=NONE");
        } else {
            uart_write_str("OK classes=");
            for (uint8_t i = 0; i < n; i++) {
                if (i > 0) {
                    uart_write_str(",");
                }
                uart_write_str(classes[i]);
            }
        }
        uart_write_line_end();
        return true;
    }
    if (strcmp(op_tok, "IS_EMPTY") == 0) {
        uart_write_str("OK empty=");
        uart_write_str(engine_scheduler_is_empty(&g_test_scheduler) ? "1" : "0");
        uart_write_line_end();
        return true;
    }
    if (strcmp(op_tok, "ALL_ITEMS") == 0) {
        engine_sched_item_t items[ENGINE_SCHED_QUEUE_CAPACITY];
        uint8_t n = engine_scheduler_all_items(&g_test_scheduler, items, ENGINE_SCHED_QUEUE_CAPACITY);
        if (n == 0) {
            uart_write_str("OK ids=NONE");
        } else {
            uart_write_str("OK ids=");
            for (uint8_t i = 0; i < n; i++) {
                if (i > 0) {
                    uart_write_str(",");
                }
                uart_write_str(items[i].id);
            }
        }
        uart_write_line_end();
        return true;
    }

    return false;
}
#endif

#if ENGINE_PERSIST_TESTHOOKS_ENABLED || ENGINE_SCHED_TESTHOOKS_ENABLED

static bool handle_testhook(char *args)
{
    char *cursor = args;
    char *name_tok = next_token(&cursor);

    if (name_tok == NULL) {
        return false;
    }

#if ENGINE_PERSIST_TESTHOOKS_ENABLED
    if (strcmp(name_tok, "LOAD") == 0) {
        return handle_testhook_load();
    }
    if (strcmp(name_tok, "CORRUPT") == 0) {
        return handle_testhook_corrupt(cursor);
    }
#endif
#if ENGINE_SCHED_TESTHOOKS_ENABLED
    if (strcmp(name_tok, "SCHED") == 0) {
        return handle_testhook_sched(cursor);
    }
#endif

    return false;
}
#endif


static void handle_line(char *line)
{
    size_t n = strlen(line);

    if (n > 0 && line[n - 1] == '\r') {
        line[n - 1] = '\0';
        n--;
    }
    if (n == 0) {
        return;
    }

    if (strncmp(line, "INJECT ", 7) == 0) {
        handle_inject(line + 7);
    } else if (strcmp(line, "INJECT") == 0) {
        reply_error("missing_fields");
    } else if (strncmp(line, "SERVICE ", 8) == 0) {
        handle_service(line + 8);
    } else if (strcmp(line, "PING") == 0) {
        uart_write_str("READY");
        uart_write_line_end();
    } else if (strncmp(line, "TESTHOOK ", 9) == 0) {
#if ENGINE_PERSIST_TESTHOOKS_ENABLED || ENGINE_SCHED_TESTHOOKS_ENABLED
        if (!handle_testhook(line + 9)) {
            reply_error("testhook_not_implemented");
        }
#else
        reply_error("testhook_not_implemented");
#endif
    } else if (strcmp(line, "TESTHOOK") == 0) {
        reply_error("testhook_not_implemented");
    } else {
        reply_error_detail("unknown_command", line);
    }
}

static void uart_dispatch_isr(const struct device *dev, void *user_data)
{
    ARG_UNUSED(user_data);
    uint8_t c;

    if (!uart_irq_update(dev)) {
        return;
    }
    if (!uart_irq_rx_ready(dev)) {
        return;
    }

    while (uart_fifo_read(dev, &c, 1) == 1) {
        if (c == '\n') {
            if (line_overflowed) {
                reply_error("line_too_long");
            } else {
                line_buf[line_len] = '\0';
                handle_line(line_buf);
            }
            line_len = 0;
            line_overflowed = false;
        } else if (c == '\r') {

        } else if (line_len < LINE_BUF_SIZE - 1) {
            line_buf[line_len++] = (char)c;
        } else {
            line_overflowed = true;
        }
    }
}

#if ENGINE_GROUND_AUTH_ENABLED

static const uint8_t TASK5_TEST_HARNESS_GROUND_AUTH_SECRET[] =
    "phase8-task5-test-harness-secret-do-not-use-in-flight";
#endif

int main(void)
{
    int ret;

    if (!device_is_ready(uart_dev)) {
        return 0;
    }

    ret = uart_irq_callback_user_data_set(uart_dev, uart_dispatch_isr, NULL);
    if (ret < 0) {
        return 0;
    }

#if ENGINE_GROUND_AUTH_ENABLED
    engine_auth_set_secret(TASK5_TEST_HARNESS_GROUND_AUTH_SECRET,
                            sizeof(TASK5_TEST_HARNESS_GROUND_AUTH_SECRET) - 1);
#endif

    uart_irq_rx_enable(uart_dev);


    uart_write_str("READY");
    uart_write_line_end();

    return 0;
}
```

## src/engine_arbitration.c
```c
#include "engine_arbitration.h"

#include <string.h>


static int compare(const engine_pending_event_t *a, const engine_pending_event_t *b)
{
    const engine_arbitration_key_t *ka = &g_event_arbitration[a->event];
    const engine_arbitration_key_t *kb = &g_event_arbitration[b->event];

    if (ka->rank != kb->rank) {
        return ka->rank < kb->rank ? -1 : 1;
    }
    if (ka->class_key != kb->class_key) {
        return ka->class_key < kb->class_key ? -1 : 1;
    }
    if (a->timestamp != b->timestamp) {
        return a->timestamp < b->timestamp ? -1 : 1;
    }
    if (ka->reset_key != kb->reset_key) {
        return ka->reset_key < kb->reset_key ? -1 : 1;
    }
    return strcmp(g_events[a->event].id, g_events[b->event].id);
}

void engine_arbitrate(const engine_pending_event_t *pending, size_t n, size_t *out_order)
{
    for (size_t i = 0; i < n; i++) {
        size_t j = i;

        while (j > 0 && compare(&pending[i], &pending[out_order[j - 1]]) < 0) {
            out_order[j] = out_order[j - 1];
            j--;
        }
        out_order[j] = i;
    }
}
```

## src/engine_arbitration.h
```c
#ifndef ENGINE_ARBITRATION_H
#define ENGINE_ARBITRATION_H

#include <stddef.h>
#include <stdint.h>

#include "engine_config_table.h"

#ifdef __cplusplus
extern "C" {
#endif

typedef struct {
    uint8_t rank;
    uint8_t class_key;
    uint8_t reset_key;
} engine_arbitration_key_t;

extern const engine_arbitration_key_t g_event_arbitration[EVENT_COUNT];

typedef struct {
    event_id_t event;
    double timestamp;
} engine_pending_event_t;


void engine_arbitrate(const engine_pending_event_t *pending, size_t n, size_t *out_order);

#ifdef __cplusplus
}
#endif

#endif
```

## src/engine_arbitration_table.c
```c
/* AUTO-GENERATED FILE -- DO NOT HAND-EDIT.
 * Generated by mcu/host_bridge/codegen_arbitration_table.py from config-a's
 * conflict_resolution table via engine.arbitration.event_static_keys().
 * Fields: rank, class_key, reset_key (see engine_arbitration.h). */
#include "engine_arbitration.h"

const engine_arbitration_key_t g_event_arbitration[EVENT_COUNT] = {
    [EVENT_E_01] = { .rank = 3u, .class_key = 0u, .reset_key = 0u },
    [EVENT_E_02] = { .rank = 3u, .class_key = 0u, .reset_key = 0u },
    [EVENT_E_03] = { .rank = 3u, .class_key = 0u, .reset_key = 0u },
    [EVENT_E_04] = { .rank = 3u, .class_key = 0u, .reset_key = 0u },
    [EVENT_E_05] = { .rank = 5u, .class_key = 0u, .reset_key = 0u },
    [EVENT_E_06] = { .rank = 4u, .class_key = 1u, .reset_key = 0u },
    [EVENT_E_07] = { .rank = 4u, .class_key = 2u, .reset_key = 0u },
    [EVENT_E_08] = { .rank = 4u, .class_key = 4u, .reset_key = 0u },
    [EVENT_E_09] = { .rank = 4u, .class_key = 5u, .reset_key = 0u },
    [EVENT_E_10] = { .rank = 4u, .class_key = 0u, .reset_key = 0u },
    [EVENT_E_11] = { .rank = 2u, .class_key = 0u, .reset_key = 0u },
    [EVENT_E_12] = { .rank = 2u, .class_key = 0u, .reset_key = 0u },
    [EVENT_E_13] = { .rank = 1u, .class_key = 0u, .reset_key = 1u },
    [EVENT_E_14] = { .rank = 1u, .class_key = 0u, .reset_key = 1u },
    [EVENT_E_15] = { .rank = 2u, .class_key = 0u, .reset_key = 0u },
    [EVENT_E_16] = { .rank = 1u, .class_key = 0u, .reset_key = 0u },
    [EVENT_E_17] = { .rank = 2u, .class_key = 0u, .reset_key = 0u },
    [EVENT_E_18] = { .rank = 5u, .class_key = 0u, .reset_key = 0u },
    [EVENT_E_19] = { .rank = 3u, .class_key = 0u, .reset_key = 0u },
    [EVENT_E_20] = { .rank = 2u, .class_key = 0u, .reset_key = 0u },
};
```

## src/engine_auth.c
```c
#include "engine_auth.h"

#include <mbedtls/md.h>

#include <stdio.h>
#include <string.h>


static uint8_t g_secret[ENGINE_AUTH_SECRET_MAX_LEN];
static size_t g_secret_len;


#define ENGINE_AUTH_MESSAGE_BUF_SIZE 128u


static bool now_is_signable(double now, long long *out_int_now)
{
    if (!(now >= 0.0) || !(now < 1e15)) {
        return false;
    }
    long long int_now = (long long)now;

    if ((double)int_now != now) {
        return false;
    }
    *out_int_now = int_now;
    return true;
}


static void hex_encode_lower(const uint8_t *bytes, size_t len, char *out)
{
    static const char digits[] = "0123456789abcdef";

    for (size_t i = 0; i < len; i++) {
        out[2 * i] = digits[(bytes[i] >> 4) & 0x0F];
        out[2 * i + 1] = digits[bytes[i] & 0x0F];
    }
    out[2 * len] = '\0';
}


static bool constant_time_hex_equal(const char *a, const char *b)
{
    unsigned char diff = 0;

    for (size_t i = 0; i < ENGINE_AUTH_SIGNATURE_HEX_LEN; i++) {
        diff |= (unsigned char)a[i] ^ (unsigned char)b[i];
    }
    return diff == 0;
}

bool engine_auth_sign_command(const char *event_id, double now,
                               const uint8_t *secret, size_t secret_len,
                               char out_hex[ENGINE_AUTH_SIGNATURE_HEX_LEN + 1])
{
    if (event_id == NULL || out_hex == NULL) {
        return false;
    }
    if (secret == NULL && secret_len != 0) {
        return false;
    }

    long long int_now = 0;

    if (!now_is_signable(now, &int_now)) {
        return false;
    }

    char message[ENGINE_AUTH_MESSAGE_BUF_SIZE];
    int written = snprintf(message, sizeof(message), "%s:%lld.0", event_id, int_now);

    if (written < 0 || (size_t)written >= sizeof(message)) {
        return false;
    }

    const mbedtls_md_info_t *md_info = mbedtls_md_info_from_type(MBEDTLS_MD_SHA256);

    if (md_info == NULL) {
        return false;
    }

    uint8_t digest[32];
    int rc = mbedtls_md_hmac(md_info, secret, secret_len,
                              (const unsigned char *)message, (size_t)written, digest);

    if (rc != 0) {
        return false;
    }

    hex_encode_lower(digest, sizeof(digest), out_hex);
    return true;
}

void engine_auth_set_secret(const uint8_t *secret, size_t secret_len)
{
    if (secret == NULL || secret_len == 0 || secret_len > ENGINE_AUTH_SECRET_MAX_LEN) {
        g_secret_len = 0;
        return;
    }
    memcpy(g_secret, secret, secret_len);
    g_secret_len = secret_len;
}

bool engine_auth_has_secret_provisioned(void)
{
    return g_secret_len > 0;
}

bool engine_auth_verify_command(const char *event_id, double now, const char *hex_signature_or_null)
{
    if (hex_signature_or_null == NULL) {
        return false;
    }
    if (g_secret_len == 0) {
        return false;
    }
    if (strlen(hex_signature_or_null) != ENGINE_AUTH_SIGNATURE_HEX_LEN) {

        return false;
    }

    char expected_hex[ENGINE_AUTH_SIGNATURE_HEX_LEN + 1];

    if (!engine_auth_sign_command(event_id, now, g_secret, g_secret_len, expected_hex)) {
        return false;
    }

    return constant_time_hex_equal(expected_hex, hex_signature_or_null);
}
```

## src/engine_auth.h
```c
#ifndef ENGINE_AUTH_H
#define ENGINE_AUTH_H

#include <stdbool.h>
#include <stddef.h>
#include <stdint.h>

#ifdef __cplusplus
extern "C" {
#endif


#define ENGINE_AUTH_SIGNATURE_HEX_LEN 64u


#define ENGINE_AUTH_SECRET_MAX_LEN 64u


bool engine_auth_verify_command(const char *event_id, double now, const char *hex_signature_or_null);


void engine_auth_set_secret(const uint8_t *secret, size_t secret_len);


bool engine_auth_has_secret_provisioned(void);


bool engine_auth_sign_command(const char *event_id, double now,
                               const uint8_t *secret, size_t secret_len,
                               char out_hex[ENGINE_AUTH_SIGNATURE_HEX_LEN + 1]);

#ifdef __cplusplus
}
#endif

#endif
```

## src/engine_config_table.h
```c
/* AUTO-GENERATED FILE -- DO NOT HAND-EDIT.
 * Generated by tools/codegen_c_table.py from config/config-a.yaml
 * Regenerate with:
 *     python3 tools/codegen_c_table.py config/config-a.yaml
 * from the repo root. Edit the source YAML and regenerate instead of
 * hand-editing this file.
 */
#ifndef ENGINE_CONFIG_TABLE_H
#define ENGINE_CONFIG_TABLE_H

#include <stdbool.h>
#include <stdint.h>

#ifdef __cplusplus
extern "C" {
#endif

/* --- states --- */
typedef enum {
    STATE_S_01,
    STATE_S_02,
    STATE_S_03,
    STATE_S_04,
    STATE_S_05,
    STATE_S_06,
    STATE_S_07,
    STATE_S_08,
    STATE_S_09,
    STATE_S_10,
    STATE_COUNT
} state_id_t;

typedef struct {
    const char *id;   /* e.g. "S-01" */
    const char *name; /* e.g. "STOWED" */
} state_def_t;

/* --- events --- */
typedef enum {
    EVENT_E_01,
    EVENT_E_02,
    EVENT_E_03,
    EVENT_E_04,
    EVENT_E_05,
    EVENT_E_06,
    EVENT_E_07,
    EVENT_E_08,
    EVENT_E_09,
    EVENT_E_10,
    EVENT_E_11,
    EVENT_E_12,
    EVENT_E_13,
    EVENT_E_14,
    EVENT_E_15,
    EVENT_E_16,
    EVENT_E_17,
    EVENT_E_18,
    EVENT_E_19,
    EVENT_E_20,
    EVENT_COUNT
} event_id_t;

typedef struct {
    const char *id;     /* e.g. "E-01" */
    const char *name;
    const char *source; /* EventDef.source verbatim, e.g. "ground" --
                           engine/fsm.py's auth short-circuit gates on
                           `config.events[event].source == "ground"` */
} event_def_t;

/* --- guard operand grammar (docs/config-schema.md) --- */
typedef enum {
    OPERAND_NONE = 0,   /* unused slot (guard-less transition) */
    OPERAND_CONTEXT,    /* context.<name>; missing -> false, not an error */
    OPERAND_TELEMETRY,  /* bare identifier; missing -> runtime hard error */
    OPERAND_PARAM,      /* index into g_parameters[] */
    OPERAND_ELAPSED,    /* index into g_timers[]; unarmed -> VAL_NONE */
    OPERAND_LITERAL_NUM,
    OPERAND_LITERAL_BOOL,
    OPERAND_LITERAL_STR,
} operand_kind_t;

typedef struct {
    operand_kind_t kind;
    const char *name;      /* CONTEXT/TELEMETRY/ELAPSED identifier, else NULL */
    int32_t param_index;   /* PARAM: index into g_parameters[], else -1 */
    int32_t timer_index;   /* ELAPSED: index into g_timers[], else -1 */
    double num_value;      /* LITERAL_NUM, else 0.0 */
    bool bool_value;       /* LITERAL_BOOL, else false */
    const char *str_value; /* LITERAL_STR, else NULL */
} guard_operand_t;

typedef enum {
    GUARD_OP_EQ = 0,
    GUARD_OP_NE,
    GUARD_OP_GE,
    GUARD_OP_LE,
    GUARD_OP_LT,
    GUARD_OP_GT,
} guard_op_t;

typedef struct {
    bool has_guard;      /* false: transition is unconditional */
    guard_op_t op;       /* unused when has_guard == false */
    guard_operand_t lhs;
    guard_operand_t rhs;
} guard_expr_t;

/* --- action string semantics (docs/config-schema.md) --- */
typedef enum {
    ACTION_OPAQUE = 0,  /* recorded verbatim in the decision log, no other effect */
    ACTION_SET_CONTEXT, /* "set context.<name> = <value>" */
    ACTION_START_TIMER, /* "start_<timer_id>" -- arms elapsed(<timer_id>) */
} action_kind_t;

typedef struct {
    action_kind_t kind;
    const char *raw;          /* original action string, verbatim, for the
                                  DECISION log's actions=<a1,a2,...> field */
    const char *context_name; /* SET_CONTEXT target name, else NULL */
    const char *timer_name;   /* START_TIMER timer id (context slot), else NULL */
    int32_t timer_index;      /* START_TIMER: index into g_timers[] if this
                                  timer is read by some elapsed() guard in this
                                  config, else -1 (armed but never read --
                                  harmless, not a build error) */
    guard_operand_t value;    /* SET_CONTEXT: literal value (LITERAL_BOOL/
                                  NUM/STR); unused for OPAQUE/START_TIMER */
} action_t;

/* --- numeric-only parameters (guard-referenced subset only; see
 * module docstring in tools/codegen_c_table.py for why the rest of
 * ParameterDef.value is dropped) --- */
typedef struct {
    const char *id; /* e.g. "P-010" */
    double value;
} parameter_t;

/* --- elapsed()/start_ timers (guard-referenced subset only) --- */
typedef struct {
    const char *id; /* e.g. "rf_inhibit_timer" */
} timer_def_t;

/* --- transitions --- */
typedef enum {
    TARGET_SELF = 0,            /* to: null -> self-loop */
    TARGET_STATE,                /* to: "<state-id>" */
    TARGET_RELOAD_PERSISTENCE,   /* to: "reload_from_persistence" */
} target_kind_t;

typedef struct {
    const char *id;         /* e.g. "T-01" */
    bool from_wildcard;      /* from: "*" in the source YAML */
    uint32_t from_mask;      /* bit i set <=> STATE_<i> is a legal origin;
                                fully set when from_wildcard == true */
    event_id_t event;
    guard_expr_t guard;
    target_kind_t target_kind;
    state_id_t to_state;     /* valid only if target_kind == TARGET_STATE;
                                STATE_COUNT (sentinel) otherwise */
    const action_t *actions;
    uint8_t actions_count;
} transition_t;

/* --- latches (engine.config_loader.LatchDef) --- */
/* Deliberately independent of action_t's ACTION_SET_CONTEXT above --
 * see engine/fsm.py's `_apply_latch_sets` docstring and this project's
 * Phase 8 Task 4 plan section ("two separate one-way-latch mechanisms
 * ... port both as independent paths, do NOT collapse them"). A
 * latch's `set_by` names g_transitions[] indices (resolved at codegen
 * time from LatchDef.set_by's transition-id strings): whenever a
 * transition whose index appears here fires, engine_fsm.c sets this
 * latch's context flag true, unconditionally -- entirely independent
 * of whatever that transition's own .actions array contains.
 * `one_way`/`survives_reset` (LatchDef fields) are traceability-only
 * in engine/fsm.py itself and are not compiled into firmware -- see
 * tools/codegen_c_table.py's LatchRow docstring. */
typedef struct {
    const char *name;       /* context flag name this latch controls */
    const uint32_t *set_by; /* g_transitions[] indices; NULL if none */
    uint32_t set_by_count;
} latch_def_t;

#define ENGINE_CONFIG_ID "config-a"
#define ENGINE_CONFIG_INITIAL_STATE STATE_S_01

extern const state_def_t g_states[STATE_COUNT];
extern const event_def_t g_events[EVENT_COUNT];
extern const parameter_t g_parameters[];
extern const uint32_t g_parameters_count;
extern const timer_def_t g_timers[];
extern const uint32_t g_timers_count;
extern const transition_t g_transitions[];
extern const uint32_t g_transitions_count;
extern const latch_def_t g_latches[];
extern const uint32_t g_latches_count;

#ifdef __cplusplus
}
#endif

#endif /* ENGINE_CONFIG_TABLE_H */
```

## src/engine_flash_ecc_stm32l4.c
```c
#include <zephyr/arch/arm/nmi.h>
#include <zephyr/init.h>
#include <zephyr/storage/flash_map.h>
#include <zephyr/sys/barrier.h>

#include <soc.h>

#define FLASH_BANK2_OFFSET 0x80000U
#define FLASH_PAGE_BYTES   2048U
#define FLASH_UNLOCK_KEY1  0x45670123U
#define FLASH_UNLOCK_KEY2  0xCDEF89ABU
#define FLASH_SR_ERRORS                                                                            \
    (FLASH_SR_OPERR | FLASH_SR_PROGERR | FLASH_SR_WRPERR | FLASH_SR_PGAERR | FLASH_SR_SIZERR |     \
     FLASH_SR_PGSERR | FLASH_SR_MISERR | FLASH_SR_FASTERR | FLASH_SR_RDERR | FLASH_SR_OPTVERR)

extern void z_SysNmiOnReset(void);

static bool in_persistence_bank(uint32_t offset)
{
    return (offset >= FIXED_PARTITION_OFFSET(slot0_partition) &&
            offset - FIXED_PARTITION_OFFSET(slot0_partition) < FIXED_PARTITION_SIZE(slot0_partition)) ||
           (offset >= FIXED_PARTITION_OFFSET(slot1_partition) &&
            offset - FIXED_PARTITION_OFFSET(slot1_partition) < FIXED_PARTITION_SIZE(slot1_partition));
}

static void wait_not_busy(void)
{
    while (FLASH->SR & FLASH_SR_BSY) {
    }
}

static void reset_data_cache(void)
{
    if (FLASH->ACR & FLASH_ACR_DCEN) {
        FLASH->ACR &= ~FLASH_ACR_DCEN;
        FLASH->ACR |= FLASH_ACR_DCRST;
        FLASH->ACR &= ~FLASH_ACR_DCRST;
        FLASH->ACR |= FLASH_ACR_DCEN;
    }
}


static bool erase_page(uint32_t offset)
{
    bool was_locked = (FLASH->CR & FLASH_CR_LOCK) != 0U;
    uint32_t page = (offset % FLASH_BANK2_OFFSET) / FLASH_PAGE_BYTES;

    wait_not_busy();
    FLASH->SR = FLASH->SR & FLASH_SR_ERRORS;
    if (was_locked) {
        FLASH->KEYR = FLASH_UNLOCK_KEY1;
        FLASH->KEYR = FLASH_UNLOCK_KEY2;
    }

    FLASH->CR &= ~(FLASH_CR_PNB | FLASH_CR_BKER);
    FLASH->CR |= FLASH_CR_PER | (page << FLASH_CR_PNB_Pos) |
                 (offset >= FLASH_BANK2_OFFSET ? FLASH_CR_BKER : 0U);
    FLASH->CR |= FLASH_CR_STRT;
    barrier_dsync_fence_full();
    wait_not_busy();
    FLASH->CR &= ~(FLASH_CR_PER | FLASH_CR_PNB | FLASH_CR_BKER);

    if (was_locked) {
        FLASH->CR |= FLASH_CR_LOCK;
    }
    reset_data_cache();
    return (FLASH->SR & FLASH_SR_ERRORS) == 0U;
}

static void ecc_nmi_handler(void)
{
    uint32_t eccr = FLASH->ECCR;
    uint32_t offset = (eccr & FLASH_ECCR_ADDR_ECC) + ((eccr & FLASH_ECCR_BK_ECC) ? FLASH_BANK2_OFFSET : 0U);

    if ((eccr & FLASH_ECCR_ECCD) == 0U || (eccr & FLASH_ECCR_SYSF_ECC) != 0U ||
        !in_persistence_bank(offset) || !erase_page(offset)) {
        z_SysNmiOnReset();
    }
    FLASH->ECCR = eccr;
}

static int install_ecc_nmi_handler(void)
{
    z_arm_nmi_set_handler(ecc_nmi_handler);
    return 0;
}

SYS_INIT(install_ecc_nmi_handler, PRE_KERNEL_1, CONFIG_KERNEL_INIT_PRIORITY_DEFAULT);
```

## src/engine_fsm.h
```c
#ifndef ENGINE_FSM_H
#define ENGINE_FSM_H

#include <stdbool.h>
#include <stdint.h>

#include "engine_config_table.h"
#include "engine_guards.h"

#ifdef __cplusplus
extern "C" {
#endif


#define ENGINE_CONTEXT_MAX_ENTRIES 8


#define ENGINE_TELEMETRY_MAX_ENTRIES 6

typedef struct {
    const char *name;
    val_t value;
} engine_context_entry_t;

typedef struct {
    engine_context_entry_t entries[ENGINE_CONTEXT_MAX_ENTRIES];
    uint32_t count;
} engine_context_t;

typedef struct {
    const char *name;
    double value;
} engine_telemetry_entry_t;

typedef struct {
    engine_telemetry_entry_t entries[ENGINE_TELEMETRY_MAX_ENTRIES];
    uint32_t count;
} engine_telemetry_t;

void engine_context_init(engine_context_t *ctx);


bool engine_context_set(engine_context_t *ctx, const char *name, val_t value);

bool engine_context_get(const engine_context_t *ctx, const char *name, val_t *out_value);

void engine_context_copy(engine_context_t *dst, const engine_context_t *src);

void engine_telemetry_init(engine_telemetry_t *tlm);


bool engine_telemetry_set(engine_telemetry_t *tlm, const char *name, double value);

bool engine_telemetry_get(const engine_telemetry_t *tlm, const char *name, double *out_value);


bool engine_lookup_state(const char *id, state_id_t *out_state);
bool engine_lookup_event(const char *id, event_id_t *out_event);


typedef struct {
    state_id_t new_state;
    const char *transition_id;
    const action_t *actions;
    uint8_t actions_count;
    bool legal;
} engine_step_result_t;

typedef enum {
    ENGINE_STEP_OK = 0,

    ENGINE_STEP_ERR_GUARD_TELEMETRY_MISSING,
} engine_step_status_t;


typedef struct {
    state_id_t state;
    engine_context_t context;
} engine_persisted_snapshot_t;


#ifndef ENGINE_GROUND_AUTH_ENABLED
#define ENGINE_GROUND_AUTH_ENABLED 0
#endif


engine_step_status_t engine_fsm_step(state_id_t state,
                                      event_id_t event,
                                      const engine_context_t *context,
                                      const engine_telemetry_t *telemetry,
                                      double now,
                                      const engine_persisted_snapshot_t *persisted,
                                      const char *ground_command_signature,
                                      engine_step_result_t *out_result,
                                      engine_context_t *out_context,
                                      const char **out_error_field);

#ifdef __cplusplus
}
#endif

#endif
```

## src/engine_guards.c
```c
#include "engine_guards.h"

#include <string.h>


guard_status_t engine_guard_resolve_operand(const guard_operand_t *operand,
                                             const guard_env_t *env,
                                             double now,
                                             val_t *out_value)
{
    switch (operand->kind) {
    case OPERAND_NONE:

        *out_value = (val_t){ .kind = VAL_NONE };
        return GUARD_OK;

    case OPERAND_LITERAL_NUM:
        *out_value = (val_t){ .kind = VAL_NUM, .num = operand->num_value };
        return GUARD_OK;

    case OPERAND_LITERAL_BOOL:
        *out_value = (val_t){ .kind = VAL_BOOL, .b = operand->bool_value };
        return GUARD_OK;

    case OPERAND_LITERAL_STR:
        *out_value = (val_t){ .kind = VAL_STR, .str = operand->str_value };
        return GUARD_OK;

    case OPERAND_CONTEXT: {

        bool value = false;
        if (env->get_context_bool != NULL) {
            (void)env->get_context_bool(env->user_data, operand->name, &value);
        }
        *out_value = (val_t){ .kind = VAL_BOOL, .b = value };
        return GUARD_OK;
    }

    case OPERAND_TELEMETRY: {
        double value = 0.0;
        bool found = env->get_telemetry_num != NULL &&
                     env->get_telemetry_num(env->user_data, operand->name, &value);
        if (!found) {

            *out_value = (val_t){ .kind = VAL_NONE };
            return GUARD_ERR_TELEMETRY_MISSING;
        }
        *out_value = (val_t){ .kind = VAL_NUM, .num = value };
        return GUARD_OK;
    }

    case OPERAND_PARAM:

        if (operand->param_index < 0 ||
            (uint32_t)operand->param_index >= g_parameters_count) {
            *out_value = (val_t){ .kind = VAL_NONE };
            return GUARD_OK;
        }
        *out_value = (val_t){ .kind = VAL_NUM, .num = g_parameters[operand->param_index].value };
        return GUARD_OK;

    case OPERAND_ELAPSED:

        if (operand->timer_index < 0 ||
            (uint32_t)operand->timer_index >= g_timers_count) {
            *out_value = (val_t){ .kind = VAL_NONE };
            return GUARD_OK;
        } else {
            double started_at = 0.0;
            bool armed = env->get_timer_started_at != NULL &&
                         env->get_timer_started_at(env->user_data, operand->timer_index, &started_at);
            if (!armed) {

                *out_value = (val_t){ .kind = VAL_NONE };
                return GUARD_OK;
            }
            *out_value = (val_t){ .kind = VAL_NUM, .num = now - started_at };
            return GUARD_OK;
        }
    }


    *out_value = (val_t){ .kind = VAL_NONE };
    return GUARD_OK;
}


static bool as_num(val_t v, double *out)
{
    if (v.kind == VAL_NUM) {
        *out = v.num;
        return true;
    }
    if (v.kind == VAL_BOOL) {
        *out = v.b ? 1.0 : 0.0;
        return true;
    }
    return false;
}

static bool values_equal(val_t a, val_t b)
{
    if (a.kind == VAL_STR || b.kind == VAL_STR) {

        if (a.kind != VAL_STR || b.kind != VAL_STR) {
            return false;
        }
        return strcmp(a.str, b.str) == 0;
    }
    double an, bn;
    if (as_num(a, &an) && as_num(b, &bn)) {
        return an == bn;
    }

    return false;
}


static bool compare_ordered(guard_op_t op, val_t lhs, val_t rhs)
{
    if (lhs.kind == VAL_STR && rhs.kind == VAL_STR) {
        int c = strcmp(lhs.str, rhs.str);
        switch (op) {
        case GUARD_OP_LT: return c < 0;
        case GUARD_OP_LE: return c <= 0;
        case GUARD_OP_GT: return c > 0;
        case GUARD_OP_GE: return c >= 0;
        default: return false;
        }
    }

    double an, bn;
    if (!as_num(lhs, &an) || !as_num(rhs, &bn)) {
        return false;
    }
    switch (op) {
    case GUARD_OP_LT: return an < bn;
    case GUARD_OP_LE: return an <= bn;
    case GUARD_OP_GT: return an > bn;
    case GUARD_OP_GE: return an >= bn;
    default: return false;
    }
}

static bool compare_values(guard_op_t op, val_t lhs, val_t rhs)
{
    switch (op) {
    case GUARD_OP_EQ: return values_equal(lhs, rhs);
    case GUARD_OP_NE: return !values_equal(lhs, rhs);
    case GUARD_OP_GE:
    case GUARD_OP_LE:
    case GUARD_OP_LT:
    case GUARD_OP_GT:
        return compare_ordered(op, lhs, rhs);
    }
    return false;
}


guard_status_t engine_guard_evaluate(const guard_expr_t *guard,
                                      const guard_env_t *env,
                                      double now,
                                      bool *out_result)
{
    if (!guard->has_guard) {

        *out_result = true;
        return GUARD_OK;
    }

    val_t lhs;
    guard_status_t status = engine_guard_resolve_operand(&guard->lhs, env, now, &lhs);
    if (status != GUARD_OK) {
        *out_result = false;
        return status;
    }

    val_t rhs;
    status = engine_guard_resolve_operand(&guard->rhs, env, now, &rhs);
    if (status != GUARD_OK) {
        *out_result = false;
        return status;
    }

    if (lhs.kind == VAL_NONE || rhs.kind == VAL_NONE) {

        *out_result = false;
        return GUARD_OK;
    }

    *out_result = compare_values(guard->op, lhs, rhs);
    return GUARD_OK;
}
```

## src/engine_guards.h
```c
#ifndef ENGINE_GUARDS_H
#define ENGINE_GUARDS_H

#include <stdbool.h>
#include <stdint.h>

#include "engine_config_table.h"

#ifdef __cplusplus
extern "C" {
#endif


typedef enum {
    VAL_NONE = 0,
    VAL_BOOL,
    VAL_NUM,
    VAL_STR,
} val_kind_t;

typedef struct {
    val_kind_t kind;
    bool b;
    double num;
    const char *str;
} val_t;


typedef enum {
    GUARD_OK = 0,
    GUARD_ERR_TELEMETRY_MISSING,
} guard_status_t;


typedef struct {

    bool (*get_context_bool)(void *user_data, const char *name, bool *out_value);


    bool (*get_telemetry_num)(void *user_data, const char *name, double *out_value);


    bool (*get_timer_started_at)(void *user_data, int32_t timer_index, double *out_started_at);

    void *user_data;
} guard_env_t;


guard_status_t engine_guard_resolve_operand(const guard_operand_t *operand,
                                             const guard_env_t *env,
                                             double now,
                                             val_t *out_value);


guard_status_t engine_guard_evaluate(const guard_expr_t *guard,
                                      const guard_env_t *env,
                                      double now,
                                      bool *out_result);

#ifdef __cplusplus
}
#endif

#endif
```
